## config/west.yml
```yaml
manifest:
  remotes:
    - name: zmkfirmware
      url-base: https://github.com/zmkfirmware
    - name: chengweiheng #new entry
      url-base: https://github.com/ChengWeiHeng #new entry
    # Additional modules containing boards/shields/custom code can be listed here as well
    # See https://docs.zephyrproject.org/3.2.0/develop/west/manifest.html#projects
  projects:
    - name: zmk
      remote: zmkfirmware
      revision: main
      import: app/west.yml
    - name: nice-view-raccoon #new entry
      remote: chengweiheng #new entry
      revision: main #new entry
  self:
    path: config
```
